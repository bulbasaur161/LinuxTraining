/dts-v1/;
/plugin/;

/{
	fragment@0 {
		target = <&leds>;
		__overlay__ {
			led6 {
				label = "red:indicator";
				gpios = <&gpio1 18 GPIO_ACTIVE_HIGH>;
				linux,default-trigger = "heartbeat";
				default-state = "off";
			};
		};

	};
};
