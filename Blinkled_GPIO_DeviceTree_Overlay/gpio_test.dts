/dts-v1/;
/plugin/;

/{
	fragment@0 {
		target = <&leds>;
		__overlay__ {
			led6 {
				label = "red:test_led";
				gpios = <&gpio1 18 GPIO_ACTIVE_HIGH>;
				linux,default-trigger = "test";
				default-state = "off";
			};
		};

	};
};
